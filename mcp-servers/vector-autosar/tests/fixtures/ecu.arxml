AUTOSAR XML (schema 00049)
package /Components
  application sw component type BrakeLightCtrl
    require port BrakePressureIn: required-interface=BrakePressure_If
package /Interfaces
  sender receiver interface BrakePressure_If
    data Pressure
